## prj.conf
```kconfig
CONFIG_RANDOM_GENERATOR=y
CONFIG_TEST_RANDOM_GENERATOR=y
```

## src/main.c
```c
/*
 * Copyright (c) 2017 Intel Corp
 *
 * SPDX-License-Identifier: Apache-2.0
 */
#include <zephyr.h>
#include <misc/printk.h>
#include <drivers/rand32.h>

int run_some_test(void)
{
	uint32_t r;
	r = sys_rand32_get();
	return r & 0x1;
}

void main(void)
{
	if (run_some_test())
		printk("PASS\n");
	else
		printk("FAIL\n");
}
```

## src/main-b.c
```c
/*
 * Copyright (c) 2017 Intel Corp
 *
 * SPDX-License-Identifier: Apache-2.0
 */
#include <zephyr.h>
#include <misc/printk.h>
#include <drivers/rand32.h>
#include <tc_util.h>

int run_some_test(void)
{
	uint32_t r;
	r = sys_rand32_get();
	return r & 0x1;
}

void main(void)
{
	int r;
	TC_START("random test");
	if (run_some_test())
		r = TC_PASS;
	else
		r = TC_FAIL;
	TC_END_RESULT(r);
	TC_END_REPORT(r);
}
```

## src/main-c.c
```c
/*
 * Copyright (c) 2017 Intel Corp
 *
 * SPDX-License-Identifier: Apache-2.0
 */
#include <zephyr.h>
#include <misc/printk.h>
#include <drivers/rand32.h>
#include <ztest.h>

void run_some_test1(void)
{
	uint32_t r = sys_rand32_get();
	zassert_true(r & 0x1, "random1");
}

void run_some_test2(void)
{
	uint32_t r = sys_rand32_get();
	zassert_true(r & 0x1, "random2");
}

void test_main(void)			/* note test_main() */
{
	ztest_test_suite(		/* declare the test suite */
		test_18,
		ztest_unit_test(run_some_test1),
		ztest_unit_test(run_some_test2));
	ztest_run_test_suite(test_18);	/* run it */
}
```
